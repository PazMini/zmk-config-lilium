
#include "lilium.dtsi"
#include <layouts/lilium/lilium.dtsi>

 / {
    chosen {
        zmk,kscan = &kscan0;
        zmk,physical-layout = &lilium_layout;
    };
};

&kscan0 {
    col-gpios =
        <&pro_micro 3 GPIO_ACTIVE_HIGH>,
        <&pro_micro 4 GPIO_ACTIVE_HIGH>,
        <&pro_micro 5 GPIO_ACTIVE_HIGH>,
        <&pro_micro 6 GPIO_ACTIVE_HIGH>,
        <&pro_micro 7 GPIO_ACTIVE_HIGH>,
        <&pro_micro 2 GPIO_ACTIVE_HIGH>;
};

&lilium_layout {
    transform = <&default_transform>;
};
